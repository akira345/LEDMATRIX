// modified by ikkei for Digit 32x16 dot matrix LED 2013.06.29
/*
 Basic LoL Shield Test
 
 Writen for the LoL Shield, designed by Jimmie Rodgers:
 http://jimmieprodgers.com/kits/lolshield/
 
 This needs the Charlieplexing library, which you can get at the
 LoL Shield project page: http://code.google.com/p/lolshield/
 
 Created by Jimmie Rodgers on 12/30/2009.
 Adapted from: http://www.arduino.cc/playground/Code/BitMath
 
 History:
  	December 30, 2009 - V1.0 first version written at 26C3/Berlin
        December 16, 2010 - modified by ikkei for ikkeiplexing shield

  This is free software; you can redistribute it and/or
  modify it under the terms of the GNU Version 3 General Public
  License as published by the Free Software Foundation; 
  or (at your option) any later version.

  This library is distributed in the hope that it will be useful,
  but WITHOUT ANY WARRANTY; without even the implied warranty of
  MERCHANTABILITY or FITNESS FOR A PARTICULAR PURPOSE.  See the GNU
  Lesser General Public License for more details.

  You should have received a copy of the GNU Lesser General Public
  License along with this library; if not, write to the Free Software
  Foundation, Inc., 51 Franklin St, Fifth Floor, Boston, MA  02110-1301  USA
*/
#include <MsTimer2.h>
#include <avr/pgmspace.h>  //AVR library for writing to ROM
#include <Digit32x16.h> //Imports the library, which needs to be
                           //Initialized in setup.

int blinkdelay = 100;      //Sets the time each frame is shown
#define TERMINATER 0x5555  // unused bit pattern

/*
The BitMap array is what contains the frame data. Each line is one full frame.
Since each number is 16 bits, we can easily fit all 16 LEDs per row into it.
The number is calculated by adding up all the bits, starting with lowest on
the left of each row. TERMINATER was chosen as the kill number, so make sure that
is at the end of the matrix, or the program will continue to read into memory.

Here PROGMEM is called, which stores the array into ROM, which leaves us
with our RAM. You cannot change the array during run-time, only when you
upload to the Arduino. You will need to pull it out of ROM, which is covered
below. If you want it to stay in RAM, just delete PROGMEM
*/

uint16_t BitMap[][8] PROGMEM = {
//Diaganal swipe across the screen
{0x0001,0x0000,0x0000,0x0000,0x0000,0x0000,0x0000,0x0000},
{0x0003,0x0001,0x0000,0x0000,0x0000,0x0000,0x0000,0x0000},
{0x0007,0x0003,0x0001,0x0000,0x0000,0x0000,0x0000,0x0000},
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{0x0000,0x0000,0x0000,0x0000,0x0000,0x0000,0x0000,0x0000},

//Horizontal swipe
{0x0001,0x0001,0x0001,0x0001,0x0001,0x0001,0x0001,0x0001},
{0x0003,0x0003,0x0003,0x0003,0x0003,0x0003,0x0003,0x0003},
{0x0007,0x0007,0x0007,0x0007,0x0007,0x0007,0x0007,0x0007},
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{0x0000,0x0000,0x0000,0x0000,0x0000,0x0000,0x0000,0x0000},

{TERMINATER}
};


void setup() {
  Digit32x16::Init();  //Initializes the screen
}
void loop() {
  DisplayBitMap();  //Displays the bitmap
}

void DisplayBitMap(){
  boolean run=true;    //While this is true, the screen updates
  byte frame = 0;      //Frame counter
  byte line = 0;       //Row counter
  unsigned long data;  //Temporary storage of the row data

  while(run == true) {
    for(line = 0; line < 8; line++) {
      //Here we fetch data from program memory with a pointer.
      data = pgm_read_word_near (&BitMap[frame][line]);
      
      //Kills the loop if the kill number is found
      if (data==TERMINATER){
        run=false;
      }
      
      //This is where the bit-shifting happens to pull out
      //each LED from a row. If the bit is 1, then the LED
      //is turned on, otherwise it is turned off.
      else for (byte led=0; led<16; ++led) {
        if (data & (1<<led)) {
          Digit32x16::Set(led, line, 1);
        }
        else {
          Digit32x16::Set(led, line, 0);
        }
      }

    }
    
    //Delays the next update
    delay(blinkdelay);        
    frame++;  
  }
}
