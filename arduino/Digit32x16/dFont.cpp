/*
  Font library

  Copyright 2009/2010 Benjamin Sonntag <benjamin@sonntag.fr> http://benjamin.sonntag.fr/
  
  History:
  	2010-01-01 - V0.0 Initial code at Berlin after 26C3
  	2010-09-10 - ikkei replaced font data to bit map font
  				 that is similar LCD SC-1602BS Standard Character Pattern
  				 and place to flash memory
  				<ikkei@zeus.eonet.ne.jp> http://blog.goo.ne.jp/jh3kxm
  	2010-09-17 - ikkei modified font data to narrow font and wide font
  	2011-12-15 - ikkei modified font data to Misaki font and add Hiragana,
  				 and delete draw function

  This library is free software; you can redistribute it and/or
  modify it under the terms of the GNU Lesser General Public
  License as published by the Free Software Foundation; either
  version 2.1 of the License, or (at your option) any later version.

  This library is distributed in the hope that it will be useful,
  but WITHOUT ANY WARRANTY; without even the implied warranty of
  MERCHANTABILITY or FITNESS FOR A PARTICULAR PURPOSE.  See the GNU
  Lesser General Public License for more details.

  You should have received a copy of the GNU Lesser General Public License
  along with this program; if not, write to the Free Software
  Foundation, Inc., 59 Temple Place - Suite 330,
  Boston, MA 02111-1307, USA.
*/



#include "dFont.h"
//#include "Digit32x16.h"
#include <inttypes.h>
#include <avr/pgmspace.h>


//### bit map font data
const uint8_t dotfont[][7] PROGMEM = {
// 0x20-0x7F data paste here
{ 0x00, 0x00, 0x00, 0x00, 0x00, 0x00, 0x00 },
{ 0x5F, 0x00, 0x00, 0x00, 0x00, 0x00, 0x00 },
{ 0x07, 0x00, 0x07, 0x00, 0x00, 0x00, 0x00 },
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{ 0x08, 0x1C, 0x2A, 0x08, 0x08, 0x08, 0x00 },



// 0x80-0xFF data paste here
{ 0x60, 0x70, 0x3F, 0x02, 0x0C, 0x00, 0x00 },
{ 0x04, 0x64, 0x3C, 0x1F, 0x3C, 0x64, 0x04 },
{ 0x1C, 0x3E, 0x7F, 0x7F, 0x7F, 0x3E, 0x1C },
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{ 0x7F, 0x7F, 0x7F, 0x7F, 0x7F, 0x00, 0x00 },



};


/* -----------------------------------------------------------------  */
/*

 */
 
uint8_t dFont::Data(uint16_t letter,int x) {
	uint16_t font_data;

	if ( letter < ' ' ) return 0;

	if ( x < 7 ){
		font_data = pgm_read_byte( &(dotfont[ letter - ' ' ][x]));
	} else {
		font_data = 0;
	}

	return font_data;
}

/* -----------------------------------------------------------------  */
/*

 */
 
uint8_t dFont::Width(uint16_t letter) {
	uint16_t maxx = 0;
	uint16_t font_data;
	uint8_t i;
	if ( letter==' ' ) return 2;
	if ( letter < ' ' ) return 0;

	for ( i=0; i<7; i++ ){
		font_data = pgm_read_byte( &(dotfont[ letter - ' ' ][i]));
		if ( font_data != 0 ){
	  		if ( i > maxx ){
	    		maxx = i;
	  		}
	  	}
	}
	return (maxx+1);
}



